## conf/layer.conf
```bitbake
# SPDX-FileCopyrightText: Copyright (c) 2026 Jason Perlow
# SPDX-License-Identifier: Apache-2.0
#
# meta-cix -- Yocto BSP layer for nclawzero on Cix Sky1 / Minisforum MS-R1.

BBPATH .= ":${LAYERDIR}"

BBFILES += " \
    ${LAYERDIR}/recipes-*/*/*.bb \
    ${LAYERDIR}/recipes-*/*/*.bbappend \
"

# wic image-recipe templates ship under wic/ and are picked up via
# WKS_SEARCH_PATH. The cixmini.wks.in here is selected by
# conf/machine/cixmini.conf WKS_FILE.
WKS_SEARCH_PATH .= ":${LAYERDIR}/wic"

BBFILE_COLLECTIONS += "cix"
BBFILE_PATTERN_cix = "^${LAYERDIR}/"
BBFILE_PRIORITY_cix = "10"

LAYERDEPENDS_cix = "core"

LAYERSERIES_COMPAT_cix = "scarthgap"
```

## conf/machine/cixmini.conf
```bitbake
# SPDX-FileCopyrightText: Copyright (c) 2026 Jason Perlow
# SPDX-License-Identifier: Apache-2.0
#
#@TYPE: Machine
#@NAME: cixmini
#@DESCRIPTION: Cix Sky1 / CP8180 machine config for Minisforum MS-R1.

require conf/machine/include/arm/arch-armv8a.inc

DEFAULTTUNE = "armv8a-crc"

MACHINEOVERRIDES =. "cix-sky1:cp8180:ms-r1:"
SOC_FAMILY = "cix-sky1:cp8180"

MACHINE_FEATURES = "acpi alsa bluetooth efi keyboard pci rtc screen usbhost vfat wifi"

KERNEL_IMAGETYPE = "Image"
PREFERRED_PROVIDER_virtual/kernel ?= "linux-cix-msr1"
PREFERRED_VERSION_linux-cix-msr1 ?= "6.6.10%"

# Sky1 boards boot through UEFI/ACPI. The Cix mainline notes require this
# kernel parameter until clock handling is fully upstreamed.
APPEND += "console=tty0 console=ttyAMA0,115200 earlycon clk_ignore_unused"

SERIAL_CONSOLES ?= "115200;ttyAMA0 115200;ttyS0"

MACHINE_EXTRA_RRECOMMENDS += " \
    kernel-modules \
    cix-audio-dsp \
"

IMAGE_FSTYPES ?= "wic.gz wic.bmap"
WKS_FILE ?= "cixmini.wks.in"

EFI_PROVIDER ?= "${@bb.utils.contains('DISTRO_FEATURES', 'systemd', 'systemd-boot', 'grub-efi', d)}"

# No initramfs by design. With CONFIG_USB_XHCI_PCI=y +
# CONFIG_USB_STORAGE=y + CONFIG_BLK_DEV_SD=y + CONFIG_EXT4_FS=y all
# built into the kernel via files/usb-rootfs.cfg, the kernel mounts
# `/dev/sda2` (rootwait + root=PARTUUID=...) directly. core-image-
# minimal-initramfs's init-live.sh is a live-USB-image init that
# expected exfat/squashfs layout; it failed to mount our ext4 root
# (rejected `umask=` mount param against ext4) and looped on
# /dev/disk/by-partuuid resolution. Going initramfs-less avoids
# that whole class of init-script disagreement.
INITRAMFS_IMAGE = ""
INITRAMFS_IMAGE_BUNDLE = "0"
```
