## conf/distro/nclawzero.conf
```bitbake
# SPDX-FileCopyrightText: Copyright (c) 2026 Jason Perlow
# SPDX-License-Identifier: Apache-2.0
#
# nclawzero distro config for Cix Sky1 first-pass Yocto images.

require conf/distro/poky.conf

DISTRO = "nclawzero"
DISTRO_NAME = "nclawzero"
DISTRO_VERSION = "2026.04"
DISTRO_CODENAME = "scarthgap"
MAINTAINER = "Jason Perlow <jperlow@gmail.com>"

TARGET_VENDOR = "-nclawzero"
SDK_VENDOR = "-nclawzerosdk"

INIT_MANAGER = "systemd"
DISTRO_FEATURES:append = " systemd usrmerge"
DISTRO_FEATURES_OPTED_OUT:append = " sysvinit"

VIRTUAL-RUNTIME_init_manager = "systemd"
VIRTUAL-RUNTIME_initscripts = "systemd-compat-units"

PACKAGE_CLASSES ?= "package_ipk"
```
